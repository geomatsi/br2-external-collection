## br2-external-system/configs/rproc_mx6sx_udoo_neo_defconfig
```kconfig
BR2_arm=y
BR2_cortex_a9=y
BR2_ARM_ENABLE_NEON=y
BR2_ARM_ENABLE_VFP=y
BR2_ARM_FPU_VFPV3=y

BR2_PACKAGE_HOST_LINUX_HEADERS_CUSTOM_5_9=y
BR2_TARGET_GENERIC_ROOT_PASSWD="root"
BR2_TARGET_GENERIC_HOSTNAME="udoo-neo"
BR2_TARGET_GENERIC_ISSUE="Welcome to Buildroot for the Udoo Neo"
BR2_SYSTEM_DHCP="wlan0"

# Toolchain
BR2_TOOLCHAIN=y
BR2_TOOLCHAIN_USES_GLIBC=y
BR2_TOOLCHAIN_BUILDROOT=y
BR2_TOOLCHAIN_BUILDROOT_CXX=y
BR2_TOOLCHAIN_BUILDROOT_GLIBC=y
BR2_TOOLCHAIN_BUILDROOT_LIBC="glibc"

# Init system
BR2_INIT_SYSTEMD=y

BR2_TARGET_ROOTFS_EXT2=y
BR2_TARGET_ROOTFS_EXT2_4=y
BR2_TARGET_ROOTFS_EXT2_SIZE="512M"
BR2_ROOTFS_POST_BUILD_SCRIPT="board/udoo/common/post-build.sh"
BR2_ROOTFS_POST_IMAGE_SCRIPT="board/freescale/common/imx/post-image.sh"
BR2_GLOBAL_PATCH_DIR="$(BR2_EXTERNAL_SYSTEM_PATH)/board/udoo/neo/patches"
BR2_ROOTFS_OVERLAY="$(BR2_EXTERNAL_SYSTEM_PATH)/board/udoo/neo/overlay/"

# Bootloader
BR2_TARGET_UBOOT=y
BR2_TARGET_UBOOT_BOARDNAME="udoo_neo"
BR2_TARGET_UBOOT_CUSTOM_VERSION=y
BR2_TARGET_UBOOT_CUSTOM_VERSION_VALUE="2020.10"
BR2_TARGET_UBOOT_FORMAT_IMG=y
BR2_TARGET_UBOOT_SPL=y
BR2_TARGET_UBOOT_SPL_NAME="SPL"

# Kernel
BR2_LINUX_KERNEL=y
BR2_LINUX_KERNEL_CUSTOM_VERSION=y
BR2_LINUX_KERNEL_CUSTOM_VERSION_VALUE="5.9"
BR2_LINUX_KERNEL_DEFCONFIG="imx_v6_v7"
BR2_LINUX_KERNEL_DTS_SUPPORT=y
BR2_LINUX_KERNEL_INTREE_DTS_NAME="imx6sx-udoo-neo-basic imx6sx-udoo-neo-full imx6sx-udoo-neo-extended"
BR2_LINUX_KERNEL_CONFIG_FRAGMENT_FILES="$(BR2_EXTERNAL_SYSTEM_PATH)/board/udoo/neo/linux.config"
BR2_LINUX_KERNEL_INSTALL_TARGET=y

# Host tools
BR2_PACKAGE_HOST_DOSFSTOOLS=y
BR2_PACKAGE_HOST_GENIMAGE=y
BR2_PACKAGE_HOST_MTOOLS=y
BR2_PACKAGE_HOST_UBOOT_TOOLS=y
BR2_PACKAGE_HOST_UBOOT_TOOLS_BOOT_SCRIPT=y
BR2_PACKAGE_HOST_UBOOT_TOOLS_BOOT_SCRIPT_SOURCE="board/udoo/common/boot.scr.txt"

# TI wireless firmware
BR2_PACKAGE_LINUX_FIRMWARE=y
BR2_PACKAGE_LINUX_FIRMWARE_TI_WL18XX=y
BR2_PACKAGE_WILINK_BT_FIRMWARE=y
BR2_PACKAGE_18XX_TI_UTILS=y

# wireless support
BR2_PACKAGE_IW=y
BR2_PACKAGE_WIRELESS_TOOLS=y
BR2_PACKAGE_WIRELESS_TOOLS_LIB=y
BR2_PACKAGE_WPA_SUPPLICANT=y
BR2_PACKAGE_WPA_SUPPLICANT_NL80211=y
BR2_PACKAGE_WPA_SUPPLICANT_CLI=y

# utils
BR2_PACKAGE_DROPBEAR=y
BR2_PACKAGE_IPROUTE2=y
BR2_PACKAGE_UTIL_LINUX_RFKILL=y

# imx support
BR2_PACKAGE_IMX_M4FWLOADER=y
BR2_PACKAGE_FREESCALE_IMX=y
BR2_PACKAGE_FIRMWARE_IMX=y
BR2_PACKAGE_LINUX_FIRMWARE_IMX_SDMA=y
```

## br2-external-system/configs/rproc_mx8qx_icore_defconfig
```kconfig
BR2_aarch64=y
BR2_cortex_a35=y
BR2_ARM_FPU_VFPV3=y

BR2_PACKAGE_HOST_LINUX_HEADERS_CUSTOM_5_4=y
BR2_TARGET_GENERIC_GETTY_PORT="ttyLP0"
BR2_TARGET_GENERIC_ROOT_PASSWD="root"
BR2_TARGET_GENERIC_HOSTNAME="mx8qx"
BR2_TARGET_GENERIC_ISSUE="Welcome to Buildroot for imx8qx"

# Toolchain
BR2_TOOLCHAIN=y
BR2_TOOLCHAIN_USES_GLIBC=y
BR2_TOOLCHAIN_BUILDROOT=y
BR2_TOOLCHAIN_BUILDROOT_CXX=y
BR2_TOOLCHAIN_BUILDROOT_GLIBC=y
BR2_TOOLCHAIN_BUILDROOT_LIBC="glibc"

# Init system
BR2_INIT_SYSTEMD=y

BR2_TARGET_ROOTFS_EXT2=y
BR2_TARGET_ROOTFS_EXT2_4=y
BR2_TARGET_ROOTFS_EXT2_SIZE="512M"
BR2_ROOTFS_POST_IMAGE_SCRIPT="board/freescale/common/imx/imx8-bootloader-prepare.sh board/freescale/common/imx/post-image.sh"
BR2_ROOTFS_POST_SCRIPT_ARGS="${UBOOT_DIR}/arch/arm/dts/fsl-imx8qxp-mek.dtb"
#BR2_GLOBAL_PATCH_DIR="$(BR2_EXTERNAL_SYSTEM_PATH)/board/imx8/icore-mx8x/patches"
#BR2_ROOTFS_OVERLAY="$(BR2_EXTERNAL_SYSTEM_PATH)/board/imx8/icore-mx8x/overlay/"

# Kernel
BR2_LINUX_KERNEL=y
BR2_LINUX_KERNEL_CUSTOM_GIT=y
BR2_LINUX_KERNEL_CUSTOM_REPO_URL="https://source.codeaurora.org/external/imx/linux-imx"
BR2_LINUX_KERNEL_CUSTOM_REPO_VERSION="rel_imx_5.4.24_2.1.0"
BR2_LINUX_KERNEL_DEFCONFIG="imx_v8"
BR2_LINUX_KERNEL_DTS_SUPPORT=y
BR2_LINUX_KERNEL_INTREE_DTS_NAME="freescale/imx8qxp-mek-rpmsg"
BR2_LINUX_KERNEL_CONFIG_FRAGMENT_FILES="$(BR2_EXTERNAL_SYSTEM_PATH)/board/imx8/icore-mx8x/linux.config"
BR2_LINUX_KERNEL_NEEDS_HOST_OPENSSL=y

# iMX8 firmware blobs
BR2_PACKAGE_FREESCALE_IMX=y
BR2_PACKAGE_FREESCALE_IMX_PLATFORM_IMX8X=y
BR2_PACKAGE_FIRMWARE_IMX=y
BR2_PACKAGE_IMX_SECO=y
BR2_PACKAGE_MX8X_ICORE_SC_FIRMWARE=y

# ATF
BR2_TARGET_ARM_TRUSTED_FIRMWARE=y
BR2_TARGET_ARM_TRUSTED_FIRMWARE_CUSTOM_GIT=y
BR2_TARGET_ARM_TRUSTED_FIRMWARE_CUSTOM_REPO_URL="https://source.codeaurora.org/external/imx/imx-atf"
BR2_TARGET_ARM_TRUSTED_FIRMWARE_CUSTOM_REPO_VERSION="rel_imx_5.4.24_2.1.0"
BR2_TARGET_ARM_TRUSTED_FIRMWARE_PLATFORM="imx8qx"
BR2_TARGET_ARM_TRUSTED_FIRMWARE_BL31=y

# U-Boot
BR2_TARGET_UBOOT=y
BR2_TARGET_UBOOT_BUILD_SYSTEM_KCONFIG=y
BR2_TARGET_UBOOT_CUSTOM_GIT=y
BR2_TARGET_UBOOT_CUSTOM_REPO_URL="https://source.codeaurora.org/external/imx/uboot-imx"
BR2_TARGET_UBOOT_CUSTOM_REPO_VERSION="rel_imx_5.4.24_2.1.0"
BR2_TARGET_UBOOT_BOARD_DEFCONFIG="imx8qxp_mek"
BR2_TARGET_UBOOT_NEEDS_DTC=y

# Host tools
BR2_PACKAGE_HOST_DOSFSTOOLS=y
BR2_PACKAGE_HOST_GENIMAGE=y
BR2_PACKAGE_HOST_IMX_MKIMAGE=y
BR2_PACKAGE_HOST_MTOOLS=y
BR2_PACKAGE_HOST_UBOOT_TOOLS=y
BR2_PACKAGE_HOST_UBOOT_TOOLS_FIT_SUPPORT=y

# utils
BR2_PACKAGE_IMX_M4FWLOADER=y
BR2_PACKAGE_DROPBEAR=y
BR2_PACKAGE_IPROUTE2=y
```

## br2-external-system/configs/rproc_stm32mp157c_dk2_defconfig
```kconfig
BR2_arm=y
BR2_cortex_a7=y

BR2_PACKAGE_HOST_LINUX_HEADERS_CUSTOM_5_13=y
BR2_TARGET_GENERIC_ROOT_PASSWD="root"
BR2_TARGET_GENERIC_HOSTNAME="stm32mp1"
BR2_TARGET_GENERIC_ISSUE="Welcome to Buildroot for the stm32mp1"
BR2_SYSTEM_DHCP="wlan0"

# Toolchain
BR2_TOOLCHAIN=y
BR2_TOOLCHAIN_USES_GLIBC=y
BR2_TOOLCHAIN_BUILDROOT=y
BR2_TOOLCHAIN_BUILDROOT_CXX=y
BR2_TOOLCHAIN_BUILDROOT_GLIBC=y
BR2_TOOLCHAIN_BUILDROOT_LIBC="glibc"

# Init system
BR2_INIT_SYSTEMD=y

BR2_TARGET_ROOTFS_EXT2=y
BR2_TARGET_ROOTFS_EXT2_4=y
BR2_TARGET_ROOTFS_EXT2_SIZE="512M"
BR2_ROOTFS_POST_IMAGE_SCRIPT="board/stmicroelectronics/common/stm32mp157/post-image.sh"
BR2_ROOTFS_OVERLAY="board/stmicroelectronics/stm32mp157c-dk2/overlay/"

# Kernel
BR2_LINUX_KERNEL=y
BR2_LINUX_KERNEL_CUSTOM_VERSION=y
BR2_LINUX_KERNEL_CUSTOM_VERSION_VALUE="5.13"
BR2_LINUX_KERNEL_USE_CUSTOM_CONFIG=y
BR2_LINUX_KERNEL_CUSTOM_CONFIG_FILE="board/stmicroelectronics/stm32mp157c-dk2/linux.config"
BR2_LINUX_KERNEL_CONFIG_FRAGMENT_FILES="$(BR2_EXTERNAL_SYSTEM_PATH)/board/stmicroelectronics/stm32mp157c-dk2/linux.config"
BR2_LINUX_KERNEL_DTS_SUPPORT=y
BR2_LINUX_KERNEL_INTREE_DTS_NAME="stm32mp157c-dk2"
BR2_LINUX_KERNEL_INSTALL_TARGET=y

# ATF
BR2_TARGET_ARM_TRUSTED_FIRMWARE=y
BR2_TARGET_ARM_TRUSTED_FIRMWARE_CUSTOM_VERSION=y
BR2_TARGET_ARM_TRUSTED_FIRMWARE_CUSTOM_VERSION_VALUE="v2.5"
BR2_TARGET_ARM_TRUSTED_FIRMWARE_PLATFORM="stm32mp1"
BR2_TARGET_ARM_TRUSTED_FIRMWARE_ADDITIONAL_VARIABLES="STM32MP_SDMMC=1 AARCH32_SP=sp_min DTB_FILE_NAME=stm32mp157c-dk2.dtb"
BR2_TARGET_ARM_TRUSTED_FIRMWARE_IMAGES="*.stm32"
BR2_TARGET_ARM_TRUSTED_FIRMWARE_NEEDS_DTC=y

# Bootloader
BR2_TARGET_UBOOT=y
BR2_TARGET_UBOOT_BUILD_SYSTEM_KCONFIG=y
BR2_TARGET_UBOOT_CUSTOM_VERSION=y
BR2_TARGET_UBOOT_CUSTOM_VERSION_VALUE="2021.10"
BR2_TARGET_UBOOT_BOARD_DEFCONFIG="stm32mp15_trusted"
# BR2_TARGET_UBOOT_FORMAT_BIN is not set
BR2_TARGET_UBOOT_FORMAT_STM32=y
BR2_TARGET_UBOOT_NEEDS_OPENSSL=y
BR2_TARGET_UBOOT_CUSTOM_MAKEOPTS="DEVICE_TREE=stm32mp157c-dk2"

# Host tools
BR2_PACKAGE_HOST_GENIMAGE=y

# utils
BR2_PACKAGE_DROPBEAR=y
BR2_PACKAGE_IPROUTE2=y
```

## br2-external-system/configs/stm32mp157c_dk2_nontrusted_defconfig
```kconfig
BR2_arm=y
BR2_cortex_a7=y

BR2_PACKAGE_HOST_LINUX_HEADERS_CUSTOM_5_12=y
BR2_TARGET_GENERIC_ROOT_PASSWD="root"
BR2_TARGET_GENERIC_HOSTNAME="stm32mp1"
BR2_TARGET_GENERIC_ISSUE="Welcome to Buildroot for the stm32mp1"

# Toolchain
BR2_TOOLCHAIN=y
BR2_TOOLCHAIN_USES_GLIBC=y
BR2_TOOLCHAIN_BUILDROOT=y
BR2_TOOLCHAIN_BUILDROOT_CXX=y
BR2_TOOLCHAIN_BUILDROOT_GLIBC=y
BR2_TOOLCHAIN_BUILDROOT_LIBC="glibc"

# Init system
BR2_INIT_SYSTEMD=y

BR2_TARGET_ROOTFS_EXT2=y
BR2_TARGET_ROOTFS_EXT2_4=y
BR2_TARGET_ROOTFS_EXT2_SIZE="512M"
BR2_ROOTFS_OVERLAY="board/stmicroelectronics/stm32mp157c-dk2/overlay/"
BR2_ROOTFS_POST_IMAGE_SCRIPT="support/scripts/genimage.sh"
BR2_ROOTFS_POST_SCRIPT_ARGS="-c $(BR2_EXTERNAL_SYSTEM_PATH)/board/stmicroelectronics/stm32mp157c-dk2/genimage.cfg"

# Kernel
BR2_LINUX_KERNEL=y
BR2_LINUX_KERNEL_CUSTOM_VERSION=y
BR2_LINUX_KERNEL_CUSTOM_VERSION_VALUE="5.12.10"
BR2_LINUX_KERNEL_USE_CUSTOM_CONFIG=y
BR2_LINUX_KERNEL_CUSTOM_CONFIG_FILE="board/stmicroelectronics/stm32mp157c-dk2/linux.config"
BR2_LINUX_KERNEL_DTS_SUPPORT=y
BR2_LINUX_KERNEL_INTREE_DTS_NAME="stm32mp157c-dk2"
BR2_LINUX_KERNEL_INSTALL_TARGET=y

# Bootloaders
BR2_TARGET_UBOOT=y
BR2_TARGET_UBOOT_BUILD_SYSTEM_KCONFIG=y
BR2_TARGET_UBOOT_CUSTOM_VERSION=y
BR2_TARGET_UBOOT_CUSTOM_VERSION_VALUE="2021.04"
BR2_TARGET_UBOOT_BOARD_DEFCONFIG="stm32mp15_basic"
BR2_TARGET_UBOOT_FORMAT_IMG=y
BR2_TARGET_UBOOT_SPL=y
BR2_TARGET_UBOOT_SPL_NAME="u-boot-spl.stm32"
BR2_TARGET_UBOOT_CUSTOM_MAKEOPTS="DEVICE_TREE=stm32mp157c-dk2"

# host tools
BR2_PACKAGE_HOST_GENIMAGE=y

# utils
BR2_PACKAGE_DROPBEAR=y
BR2_PACKAGE_IPROUTE2=y
```

## br2-external-system/package/catatonit/Config.in
```kconfig
config BR2_PACKAGE_CATATONIT
	bool "catatonit"
	help
	  A simple container init.
```

## br2-external-system/package/cni-plugins/Config.in
```kconfig
config BR2_PACKAGE_CNI_PLUGINS
	bool "cni-plugins"
	depends on BR2_PACKAGE_HOST_GO_TARGET_ARCH_SUPPORTS
	depends on BR2_PACKAGE_HOST_GO_TARGET_CGO_LINKING_SUPPORTS
	depends on BR2_TOOLCHAIN_HAS_THREADS
	help
	  CNI network plugins, maintained by the containernetworking team.
```

## br2-external-system/package/cni/Config.in
```kconfig
config BR2_PACKAGE_CNI
	bool "cni"
	depends on BR2_PACKAGE_HOST_GO_TARGET_ARCH_SUPPORTS
	depends on BR2_PACKAGE_HOST_GO_TARGET_CGO_LINKING_SUPPORTS
	depends on BR2_TOOLCHAIN_HAS_THREADS
	select BR2_PACKAGE_CNI_PLUGINS
	help
	  Container Network Interface - networking for Linux containers.
```

## br2-external-system/package/conmon/Config.in
```kconfig
config BR2_PACKAGE_CONMON
	bool "conmon"
	depends on BR2_TOOLCHAIN_HAS_THREADS
	select BR2_PACKAGE_LIBGLIB2
	select BR2_PACKAGE_RUNC
	help
	  An OCI container runtime monitor.
```

## br2-external-system/package/cri-o/Config.in
```kconfig
config BR2_PACKAGE_CRI_O
	bool "cri-o"
	depends on BR2_PACKAGE_HOST_GO_TARGET_ARCH_SUPPORTS
	depends on BR2_PACKAGE_HOST_GO_TARGET_CGO_LINKING_SUPPORTS
	depends on BR2_TOOLCHAIN_HAS_THREADS
	select BR2_PACKAGE_RUNC
	select BR2_PACKAGE_CONMON
	select BR2_PACKAGE_CNI
	select BR2_PACKAGE_BTRFS_PROGS
	select BR2_PACKAGE_LIBGPGME
	select BR2_PACKAGE_LVM2
	select BR2_PACKAGE_E2FSPROGS
	select BR2_PACKAGE_UTIL_LINUX
	select BR2_PACKAGE_IPTABLES
	select BR2_PACKAGE_CGROUPFS_MOUNT
	select BR2_PACKAGE_CONNTRACK_TOOLS
	select BR2_PACKAGE_UTIL_LINUX_PIVOT_ROOT
	select BR2_PACKAGE_UTIL_LINUX_MOUNTPOINT
	help
	  CRI-O - OCI-based implementation of Kubernetes Container Runtime Interface.
```

## br2-external-system/package/mx8x-icore-sc-firmware/Config.in
```kconfig
config BR2_PACKAGE_MX8X_ICORE_SC_FIRMWARE
	bool "mx8x-icore-sc-firmware"
	depends on BR2_aarch64
	help
	  System Control Unit Firmware blobs for the Engicam mx8x iCore SOM modules.

	  This library is provided by Engicam as-is and doesn't have an upstream.
```

## br2-external-system/package/podman/Config.in
```kconfig
config BR2_PACKAGE_PODMAN
	bool "podman"
	depends on BR2_PACKAGE_HOST_GO_TARGET_ARCH_SUPPORTS
	depends on BR2_PACKAGE_HOST_GO_TARGET_CGO_LINKING_SUPPORTS
	depends on BR2_TOOLCHAIN_HAS_THREADS
	select BR2_PACKAGE_BTRFS_PROGS
	select BR2_PACKAGE_LIBSECCOMP
	select BR2_PACKAGE_CRUN
	select BR2_PACKAGE_CONMON
	select BR2_PACKAGE_CATATONIT
	select BR2_PACKAGE_CNI
	select BR2_PACKAGE_LIBGPGME
	select BR2_PACKAGE_LVM2
	select BR2_PACKAGE_E2FSPROGS
	select BR2_PACKAGE_UTIL_LINUX
	select BR2_PACKAGE_IPTABLES
	select BR2_PACKAGE_CGROUPFS_MOUNT if !BR2_INIT_SYSTEMD
	select BR2_PACKAGE_CONNTRACK_TOOLS
	select BR2_PACKAGE_UTIL_LINUX_PIVOT_ROOT
	select BR2_PACKAGE_UTIL_LINUX_MOUNTPOINT
	help
	  Podman is a daemonless container engine for developing, managing,
	  and running OCI Containers on your Linux System. Containers can
	  either be run as root or in rootless mode.
```
